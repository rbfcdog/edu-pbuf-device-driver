## drivers/lkcamp/Kconfig
```kconfig
# SPDX-License-Identifier: GPL-2.0-only

menu "LKCAMP educational drivers"

config EDU_CHAT
	tristate "Educational local chat room character driver"
	default m
	help
	  Builds /dev/edu_chat, an educational pseudo character driver
	  based on the LKCAMP device-driver tutorial.

	  The driver simulates a local chat room where processes can
	  exchange messages by writing to and reading from
	  /dev/edu_chat. User space processes send chat messages via
	  write(), and other processes can read the conversation,
	  wait for new messages through blocking read or poll/select,
	  and configure chat behavior through ioctl or sysfs
	  attributes.

	  To build it as a module, choose M. The module will be called
	  edu_chat.

endmenu
```
